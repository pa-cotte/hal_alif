## ble/zephyr/Kconfig
```kconfig
# Copyright 2023 Alif Semiconductor

# Bluetooth related configurations

if ALIF_BLE_HOST

menu "Alif BLE stack"

config ALIF_BLE_HOST_PATCHING
	bool "Apply a patch to the Alif BLE host stack"
	default n
	help
	  Apply a patch to the BLE host stack in ROM. This enables ROM functions to be overridden
	  using a patched version.

config ALIF_BLE_HOST_PATCH_FILE
	string
	depends on ALIF_BLE_HOST_PATCHING
	  default "${ZEPHYR_ALIF_MODULE_DIR}/ble/rom_ble_stack.patch.elf"

config ALIF_BLE_HOST_THREAD_PRIORITY
	int "Priority for thread running the BLE host stack"
	default MAIN_THREAD_PRIORITY
	help
	  Set the thread priority for the BLE host stack thread.
	  The ROM host stack is not thread-safe, so calls to ROM
	  APIs should be performed from a thread with the same
	  priority as the host stack thread. This defaults to the
	  same priority as the main thread so that host stack APIs
	  can be called from main().

config ALIF_BLE_HOST_THREAD_STACKSIZE
	int "Stack size for thread running the BLE host stack"
	default 4096

config ALIF_BLE_HOST_ADDL_PRF_HEAPSIZE
	int "Additional heap size required for supported profiles"
	default 0
	help
	  Depending on the profiles enabled in the stack the profile
	  heap size allocated needs to be adjusted.

endmenu

endif
```

## common/zephyr/Kconfig
```kconfig
config ALIF_PM_LE_CODED_PHY_500
	int "LE Coded PHY 500 Kbps selection"
	depends on HAS_ALIF_POWER_MANAGER
	depends on HAS_ALIF_SE_SERVICES
	default 0

config ALIF_PM_DFT_SLAVE_MD
	int "Default MD bit used by slave when sending a data packet on a BLE connection"
	depends on HAS_ALIF_POWER_MANAGER
	depends on HAS_ALIF_SE_SERVICES
	default 0

config ALIF_PM_CH_CLASS_REP_INTV
	int "Channel classification reporting interval (in ms) (0 if not used)"
	depends on HAS_ALIF_POWER_MANAGER
	depends on HAS_ALIF_SE_SERVICES
	default 0

# config ALIF_PM_BD_ADDRESS
# 	string "Local Bd Address"
# 	depends on HAS_ALIF_POWER_MANAGER
# 	depends on HAS_ALIF_SE_SERVICES
# 	default {0x01, 0x23, 0x45, 0x67, 0x89, 0xAB}

config ALIF_PM_ACTIVITY_MOVE_CONFIG
	int "Activity Move Configuration (enables/disables activity move for BLE connections and BT (e)SCO links)"
	depends on HAS_ALIF_POWER_MANAGER
	depends on HAS_ALIF_SE_SERVICES
	default 1

config ALIF_PM_SCAN_EXT_ADV
	int "Enable/disable scanning for extended advertising PDUs"
	depends on HAS_ALIF_POWER_MANAGER
	depends on HAS_ALIF_SE_SERVICES
	default 1

config ALIF_PM_RSSI_HIGH_THR
	int "RSSI high threshold"
	depends on HAS_ALIF_POWER_MANAGER
	depends on HAS_ALIF_SE_SERVICES
	default -40

config ALIF_PM_RSSI_LOW_THR
	int "RSSI low threshold"
	depends on HAS_ALIF_POWER_MANAGER
	depends on HAS_ALIF_SE_SERVICES
	default -60

config ALIF_PM_SLEEP_ENABLE
	int "Enable sleep mode"
	depends on HAS_ALIF_POWER_MANAGER
	depends on HAS_ALIF_SE_SERVICES
	default 1

config ALIF_PM_EXT_WAKEUP_ENABLE
	int "Enable External Wakeup"
	depends on HAS_ALIF_POWER_MANAGER
	depends on HAS_ALIF_SE_SERVICES
	default 1

config ALIF_PM_ENABLE_CH_ASSESSMENT
	int "Enable/disable channel assessment for BLE"
	depends on HAS_ALIF_POWER_MANAGER
	depends on HAS_ALIF_SE_SERVICES
	default 1

config ALIF_PM_RSSI_INTERF_THR
	int "RSSI interference threshold"
	depends on HAS_ALIF_POWER_MANAGER
	depends on HAS_ALIF_SE_SERVICES
	default -70

# TODO: change default to 3000000 in final product
config ALIF_PM_LL_UART_BAUDRATE
	int "UART baudrate between cores. Must match with application's baudrate"
	depends on HAS_ALIF_POWER_MANAGER
	depends on HAS_ALIF_SE_SERVICES
	range 115200 3000000
	default 1000000
```

## ieee802154/Kconfig
```kconfig
# Copyright 2023 Alif Semiconductor

# 802.15.4 related configurations

config IEEE802154_ALIF_SUPPORT
	bool "include 802.15.4 support"
	depends on HAVE_BLE_802154_LINK_LAYER
	help
	  This option enables Alif Semiconductor's 802.15.4 HW adaptation.
```

## lc3/zephyr/Kconfig
```kconfig
# LC3 codec related configurations

menuconfig ALIF_ROM_LC3_CODEC
	bool "Enable usage of the LC3 codec in ROM"
	depends on HAS_ALIF_BLE_ROM_IMAGE
	select FPU
	help
	  Allow the LC3 codec in ROM to be used.

if ALIF_ROM_LC3_CODEC

config ALIF_LC3_CODEC_PATCHING
	bool "Apply a patch to the Alif ROM LC3 codec"
	help
	  Apply a patch to the LC3 codec in ROM. This enables ROM functions to be overridden
	  using a patched version.

endif # ALIF_ROM_LC3_CODEC
```

## se_services/zephyr/Kconfig
```kconfig
# Copyright (C) 2023 Alif Semiconductor - All Rights Reserved.
# Use, distribution and modification of this code is permitted under the
# terms stated in the Alif Semiconductor Software License Agreement
#
# You should have received a copy of the Alif Semiconductor Software
# License Agreement with this file. If not, please write to:
# contact@alifsemi.com, or visit: https://alifsemi.com/license
config SE_SERVICE_INIT_PRIORITY
	int "SE service MHUv2 nodes Init priority"
	depends on ARM_MHUV2
	default 45
	help
	  SE service MHUv2 nodes initialization priority.

config SE_SERVICE_RF_CORE_FREQUENCY
	int "RF Core clock frequency"
	default 4
	help
	  Valid values are 0, 4, 12.
```

## zephyr/Kconfig
```kconfig
# BLE host stack related configurations

choice BT_STACK_SELECTION
	prompt "Bluetooth Stack Selection"
	default BT_HCI
	depends on HAVE_BLE_802154_LINK_LAYER
	help
	  Select the Bluetooth stack to compile.

config BT_HCI
	bool "HCI-based"
	help
	  HCI-based stack with optional host & controller parts and an
	  HCI driver in between.

config BT_CUSTOM
	bool "Alif's BLE Host stack"
	select ALIF_BLE_HOST
	help
	  Alif Semiconductor BLE boards have host stack on ROM and by selecting
	  this option it becomes available as a build option.

endchoice

config ALIF_BLE_HOST
	bool
	select ALIF_ROM_INCLUDED
	select FPU
	help
	  This option enables Alif Semiconductor's BLE Host Stack.

config ALIF_ROM_INCLUDED
	bool
	depends on HAVE_BLE_HOST_ROM_IMAGE
	select HAVE_CUSTOM_LINKER_SCRIPT
	help
	  This option enables Alif Semiconductor's BLE Host Stack, LC3 codec and 802.15.4 messaging.

if ALIF_ROM_INCLUDED
config CUSTOM_LINKER_SCRIPT
	string
	default "${ZEPHYR_ALIF_MODULE_DIR}/linker_add_rom_symbols.ld"

endif # ALIF_ROM_INCLUDED


source "$(ZEPHYR_ALIF_MODULE_DIR)/se_services/zephyr/Kconfig"
source "$(ZEPHYR_ALIF_MODULE_DIR)/common/zephyr/Kconfig"
source "$(ZEPHYR_ALIF_MODULE_DIR)/lc3/zephyr/Kconfig"
source "$(ZEPHYR_ALIF_MODULE_DIR)/ieee802154/Kconfig"
source "$(ZEPHYR_ALIF_MODULE_DIR)/ble/zephyr/Kconfig"
```
